## config/west.yml
```yaml
manifest:
  defaults:
    revision: v25.11
  remotes:
    - name: zmkfirmware
      url-base: https://github.com/moergo-sc
  projects:
    - name: zmk
      remote: zmkfirmware
      import: app/west.yml
  self:
    path: config
```
